## conf/layer.conf
```bitbake
# We have a conf and classes directory, add to BBPATH
BBPATH .= ":${LAYERDIR}"

# We have recipes-* directories, add to BBFILES
BBFILES += "${LAYERDIR}/recipes-*/*/*.bb \
            ${LAYERDIR}/recipes-*/*/*.bbappend"

BBFILE_COLLECTIONS += "meta-brandon"
BBFILE_PATTERN_meta-brandon = "^${LAYERDIR}/"
BBFILE_PRIORITY_meta-brandon = "10"

LAYERDEPENDS_meta-brandon = "core"
LAYERSERIES_COMPAT_meta-brandon = "walnascar"
```
